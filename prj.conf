## CMakeLists.txt
```
# SPDX-License-Identifier: Apache-2.0

cmake_minimum_required(VERSION 3.20.0)

find_package(Zephyr REQUIRED HINTS $ENV{ZEPHYR_BASE})
project(ble_to_hid)

target_sources(app PRIVATE
    src/main.c
    src/usb_hid.c
    src/ble_central.c
    src/hogp_client.c
    src/pairing.c
    src/hid_bridge.c
)
```

## prj.conf
```kconfig
# SPDX-License-Identifier: Apache-2.0

# General
CONFIG_HEAP_MEM_POOL_SIZE=4096
CONFIG_MAIN_STACK_SIZE=2048
CONFIG_SYSTEM_WORKQUEUE_STACK_SIZE=2048

# Logging
CONFIG_LOG=y
CONFIG_LOG_DEFAULT_LEVEL=3
CONFIG_LOG_BUFFER_SIZE=4096
# Reduce BT spam
CONFIG_BT_DEBUG_LOG=n

# Bluetooth
CONFIG_BT=y
CONFIG_BT_CENTRAL=y
CONFIG_BT_GATT_CLIENT=y
CONFIG_BT_GATT_DM=y
CONFIG_BT_HOGP=y
CONFIG_BT_SCAN=y
CONFIG_BT_SCAN_FILTER_ENABLE=y
CONFIG_BT_SCAN_UUID_CNT=1
CONFIG_BT_SCAN_NAME_CNT=1
CONFIG_BT_SCAN_ADDRESS_CNT=5
CONFIG_BT_SCAN_WITH_IDENTITY=y

# Bluetooth Security (Pairing with Passkey)
CONFIG_BT_SMP=y
CONFIG_BT_BONDABLE=y
CONFIG_BT_BONDING_REQUIRED=y
CONFIG_BT_SETTINGS=y
CONFIG_BT_KEYS_OVERWRITE_OLDEST=y
CONFIG_BT_MAX_PAIRED=5

# Flash storage for bonds
CONFIG_FLASH=y
CONFIG_FLASH_PAGE_LAYOUT=y
CONFIG_FLASH_MAP=y
CONFIG_NVS=y
CONFIG_SETTINGS=y
CONFIG_SETTINGS_NVS=y

# USB Device Stack
CONFIG_USB_DEVICE_STACK=y
CONFIG_USB_DEVICE_VID=0x1915
CONFIG_USB_DEVICE_PID=0x520F
CONFIG_USB_DEVICE_PRODUCT="BLE-HID Bridge"
CONFIG_USB_DEVICE_MANUFACTURER="Custom"
CONFIG_USB_DEVICE_INITIALIZE_AT_BOOT=n

# USB HID
CONFIG_USB_DEVICE_HID=y
CONFIG_USB_HID_DEVICE_COUNT=1
CONFIG_USB_HID_BOOT_PROTOCOL=y
CONFIG_USB_HID_POLL_INTERVAL_MS=1
CONFIG_ENABLE_HID_INT_OUT_EP=n

# USB CDC ACM for Serial Console (Passkey Display)
CONFIG_USB_CDC_ACM=y
CONFIG_SERIAL=y
CONFIG_CONSOLE=y
CONFIG_UART_CONSOLE=y
CONFIG_UART_LINE_CTRL=y

# GPIO for LED status
CONFIG_GPIO=y
```

## app.overlay
```dts
/* SPDX-License-Identifier: Apache-2.0 */

/ {
	chosen {
		zephyr,console = &cdc_acm_uart0;
	};
};

&zephyr_udc0 {
	cdc_acm_uart0: cdc_acm_uart0 {
		compatible = "zephyr,cdc-acm-uart";
	};
};
```

## src/main.c
```c
/* SPDX-License-Identifier: Apache-2.0 */

/*
 * BLE-to-USB-HID Bridge for XIAO-nRF52840
 *
 * This firmware connects to a Corne wireless keyboard via Bluetooth
 * and presents itself as a USB HID keyboard to the host computer.
 * Designed for use with Deskhop KVM switch.
 *
 * Flow:
 * 1. USB initializes and enumerates as HID keyboard
 * 2. BLE scans for HID devices (Corne keyboard)
 * 3. Connects and pairs (passkey displayed on USB serial)
 * 4. Subscribes to boot keyboard reports
 * 5. Forwards all reports from BLE to USB
 */

#include <zephyr/kernel.h>
#include <zephyr/device.h>
#include <zephyr/drivers/gpio.h>
#include <zephyr/drivers/uart.h>
#include <zephyr/usb/usb_device.h>
#include <zephyr/logging/log.h>

#include "usb_hid.h"
#include "ble_central.h"
#include "hid_bridge.h"
#include "pairing.h"

LOG_MODULE_REGISTER(main, LOG_LEVEL_INF);

/* Status LED - blinks during scanning, solid when connected */
static const struct gpio_dt_spec status_led = GPIO_DT_SPEC_GET_OR(DT_ALIAS(led0), gpios, {0});

/* Console UART for command input */
static const struct device *console_dev = DEVICE_DT_GET(DT_CHOSEN(zephyr_console));

/* Command state for bond clearing confirmation */
static bool awaiting_clear_confirm = false;

static void print_banner(void)
{
	printk("\n");
	printk("========================================\n");
	printk("  BLE-to-USB-HID Bridge\n");
	printk("  for XIAO-nRF52840\n");
	printk("========================================\n");
	printk("\n");
	printk("This device bridges a Bluetooth HID keyboard\n");
	printk("to USB for use with Deskhop KVM.\n");
	printk("\n");
	printk("Pairing passkeys will be displayed here.\n");
	printk("Connect with: screen /dev/tty.usbmodem*\n");
	printk("\n");
	printk("Commands:\n");
	printk("  c - Clear all Bluetooth bonds\n");
	printk("\n");
}

/*
 * Process serial command input
 * Returns true if a command was processed
 */
static void process_serial_commands(void)
{
	unsigned char c;

	/* Non-blocking poll for input */
	while (uart_poll_in(console_dev, &c) == 0) {
		if (awaiting_clear_confirm) {
			if (c == 'y' || c == 'Y') {
				printk("\nClearing all Bluetooth bonds...\n");
				pairing_clear_bonds();
				printk("All bonds cleared. Device will scan for new keyboards.\n");
				printk("You may need to put your keyboard in pairing mode again.\n\n");

				/* Restart scanning if not connected */
				if (!ble_central_is_connected()) {
					ble_central_start_scan();
				}
			} else if (c == 'n' || c == 'N') {
				printk("\nBond clearing cancelled.\n\n");
			} else {
				printk("\nInvalid input. Bond clearing cancelled.\n\n");
			}
			awaiting_clear_confirm = false;
		} else if (c == 'c' || c == 'C') {
			printk("\n");
			printk("========================================\n");
			printk("  CLEAR ALL BLUETOOTH BONDS?\n");
			printk("========================================\n");
			printk("This will remove all paired devices.\n");
			printk("You will need to re-pair your keyboard.\n");
			printk("\n");
			printk("Press 'y' to confirm, any other key to cancel: ");
			awaiting_clear_confirm = true;
		}
	}
}

int main(void)
{
	int err;

	LOG_INF("BLE-to-USB-HID Bridge starting...");

	/* Initialize USB HID keyboard first (before USB is enabled) */
	LOG_INF("Initializing USB HID...");
	err = app_usb_hid_init();
	if (err) {
		LOG_ERR("USB HID init failed: %d", err);
		/* Continue anyway - BLE scanning might still work */
	}

	/* Wait for USB to enumerate and console to be ready */
	LOG_INF("Waiting for USB enumeration...");
	k_msleep(2000);

	print_banner();
	k_msleep(100);

	/* Initialize HID bridge (also initializes HOGP client) */
	printk("Initializing HID bridge...\n");
	err = hid_bridge_init();
	if (err) {
		printk("ERROR: HID bridge init failed: %d\n", err);
		return err;
	}
	printk("HID bridge OK\n");
	k_msleep(100);

	/* Initialize BLE central */
	printk("Initializing BLE...\n");
	err = ble_central_init();
	if (err) {
		printk("ERROR: BLE init failed: %d\n", err);
		return err;
	}
	printk("BLE OK\n");
	k_msleep(100);

	/* Start scanning for HID devices */
	printk("Starting BLE scan...\n");
	err = ble_central_start_scan();
	if (err) {
		printk("ERROR: Failed to start scanning: %d\n", err);
		return err;
	}

	printk("\n");
	printk("==========================================\n");
	printk("  SCANNING FOR BLUETOOTH HID KEYBOARDS\n");
	printk("==========================================\n");
	printk("Put your keyboard in pairing mode now.\n");
	printk("(For Magic Keyboard: hold power 5+ sec)\n");
	printk("\n");

	/* Verify console device is ready */
	if (!device_is_ready(console_dev)) {
		LOG_WRN("Console device not ready - serial commands disabled");
	}

	/* Main loop - status monitoring */
	bool was_connected = false;
	int blink_counter = 0;

	while (1) {
		/* Check for serial commands */
		if (device_is_ready(console_dev)) {
			process_serial_commands();
		}

		bool connected = ble_central_is_connected();

		if (connected != was_connected) {
			if (connected) {
				LOG_INF("=== CONNECTED ===");
				printk("\nConnected to Bluetooth keyboard!\n\n");
				/* Solid LED when connected */
				if (status_led.port) {
					gpio_pin_set_dt(&status_led, 1);
				}
			} else {
				LOG_INF("=== DISCONNECTED ===");
				printk("\nDisconnected from Bluetooth keyboard.\n");
				printk("Scanning for devices...\n\n");
			}
			was_connected = connected;
		}

		/* Blink LED while scanning */
		if (!connected && status_led.port) {
			blink_counter++;
			if (blink_counter >= 10) {
				gpio_pin_toggle_dt(&status_led);
				blink_counter = 0;
			}
		}

		k_msleep(100);
	}

	return 0;
}
```

## src/ble_central.c
```c
/* SPDX-License-Identifier: Apache-2.0 */

#include <zephyr/kernel.h>
#include <zephyr/bluetooth/bluetooth.h>
#include <zephyr/bluetooth/hci.h>
#include <zephyr/bluetooth/conn.h>
#include <zephyr/bluetooth/uuid.h>
#include <zephyr/bluetooth/gatt.h>
#include <zephyr/settings/settings.h>
#include <bluetooth/scan.h>
#include <zephyr/logging/log.h>

#include "ble_central.h"
#include "hogp_client.h"
#include "pairing.h"
#include "hid_bridge.h"

LOG_MODULE_REGISTER(ble_central, LOG_LEVEL_INF);

/* HID Service UUID */
static struct bt_uuid_16 hid_uuid = BT_UUID_INIT_16(BT_UUID_HIDS_VAL);

static struct bt_conn *current_conn;
static bool scanning;

/* Buffer to store discovered device name */
static char discovered_name[32];

/* Helper to extract device name from advertising data */
static bool parse_device_name(struct bt_data *data, void *user_data)
{
	char *name = user_data;

	switch (data->type) {
	case BT_DATA_NAME_SHORTENED:
	case BT_DATA_NAME_COMPLETE:
		memcpy(name, data->data, MIN(data->data_len, 31));
		name[MIN(data->data_len, 31)] = '\0';
		return false; /* Stop parsing */
	default:
		return true; /* Continue parsing */
	}
}

/* BLE connection parameters for low latency */
static struct bt_le_conn_param conn_param = {
	.interval_min = 6,   /* 7.5ms (6 * 1.25ms) */
	.interval_max = 12,  /* 15ms (12 * 1.25ms) */
	.latency = 0,
	.timeout = 400,      /* 4s */
};

static void scan_filter_match(struct bt_scan_device_info *device_info,
			      struct bt_scan_filter_match *filter_match,
			      bool connectable)
{
	char addr[BT_ADDR_LE_STR_LEN];

	if (!connectable) {
		return;
	}

	bt_addr_le_to_str(device_info->recv_info->addr, addr, sizeof(addr));

	/* Extract device name from advertising data */
	discovered_name[0] = '\0';
	bt_data_parse(device_info->adv_data, parse_device_name, discovered_name);

	if (discovered_name[0] != '\0') {
		LOG_INF("Found HID device: \"%s\" [%s] RSSI %d",
			discovered_name, addr, device_info->recv_info->rssi);
		printk("\n>>> Found: \"%s\" [%s] RSSI %d\n",
		       discovered_name, addr, device_info->recv_info->rssi);
	} else {
		LOG_INF("Found HID device: [%s] RSSI %d (no name)",
			addr, device_info->recv_info->rssi);
		printk("\n>>> Found: [%s] RSSI %d (no name)\n",
		       addr, device_info->recv_info->rssi);
	}
}

static void scan_connecting_error(struct bt_scan_device_info *device_info)
{
	LOG_WRN("Connecting failed");
}

static void scan_connecting(struct bt_scan_device_info *device_info,
			    struct bt_conn *conn)
{
	if (discovered_name[0] != '\0') {
		LOG_INF("Connecting to \"%s\"...", discovered_name);
		printk("Connecting to \"%s\"...\n", discovered_name);
	} else {
		LOG_INF("Connecting to device...");
		printk("Connecting to device...\n");
	}
	current_conn = bt_conn_ref(conn);
}

/* Debug: Show ALL BLE devices (not just filtered ones) */
static void scan_recv_cb(const struct bt_le_scan_recv_info *info,
			 struct net_buf_simple *buf)
{
	char addr[BT_ADDR_LE_STR_LEN];
	char name[32] = "(unknown)";

	/* Only show connectable devices */
	if (!(info->adv_props & BT_GAP_ADV_PROP_CONNECTABLE)) {
		return;
	}

	bt_addr_le_to_str(info->addr, addr, sizeof(addr));

	/* Try to extract name from advertising data */
	struct net_buf_simple_state state;
	net_buf_simple_save(buf, &state);

	while (buf->len > 1) {
		uint8_t len = net_buf_simple_pull_u8(buf);
		if (len == 0 || len > buf->len) {
			break;
		}
		uint8_t type = net_buf_simple_pull_u8(buf);
		if (type == BT_DATA_NAME_COMPLETE || type == BT_DATA_NAME_SHORTENED) {
			uint8_t name_len = MIN(len - 1, sizeof(name) - 1);
			memcpy(name, buf->data, name_len);
			name[name_len] = '\0';
			break;
		}
		net_buf_simple_pull(buf, len - 1);
	}

	net_buf_simple_restore(buf, &state);

	/* Only print devices with names (to reduce spam) */
	if (name[0] != '(' && info->rssi > -80) {
		printk("[DEBUG] BLE device: \"%s\" [%s] RSSI %d\n", name, addr, info->rssi);
	}
}

static struct bt_le_scan_cb scan_debug_cb = {
	.recv = scan_recv_cb,
};

BT_SCAN_CB_INIT(scan_cb, scan_filter_match, NULL,
		scan_connecting_error, scan_connecting);

static void connected(struct bt_conn *conn, uint8_t err)
{
	char addr[BT_ADDR_LE_STR_LEN];

	bt_addr_le_to_str(bt_conn_get_dst(conn), addr, sizeof(addr));

	if (err) {
		LOG_ERR("Failed to connect to %s (err %u)", addr, err);
		if (current_conn) {
			bt_conn_unref(current_conn);
			current_conn = NULL;
		}
		/* Restart scanning */
		scanning = false;
		ble_central_start_scan();
		return;
	}

	LOG_INF("Connected: %s", addr);

	scanning = false;

	/* Request connection parameter update for low latency */
	int ret = bt_conn_le_param_update(conn, &conn_param);
	if (ret) {
		LOG_WRN("Failed to request connection params update: %d", ret);
	}

	/* Set security level to trigger pairing */
	ret = bt_conn_set_security(conn, BT_SECURITY_L2);
	if (ret) {
		LOG_ERR("Failed to set security: %d", ret);
	}
}

static void disconnected(struct bt_conn *conn, uint8_t reason)
{
	char addr[BT_ADDR_LE_STR_LEN];

	bt_addr_le_to_str(bt_conn_get_dst(conn), addr, sizeof(addr));
	LOG_INF("Disconnected: %s (reason %u)", addr, reason);

	/* Release all keys on USB to prevent stuck keys */
	hid_bridge_on_disconnect();

	if (current_conn) {
		bt_conn_unref(current_conn);
		current_conn = NULL;
	}

	/* Restart scanning to reconnect */
	scanning = false;
	ble_central_start_scan();
}

static void security_changed(struct bt_conn *conn, bt_security_t level,
			     enum bt_security_err err)
{
	char addr[BT_ADDR_LE_STR_LEN];

	bt_addr_le_to_str(bt_conn_get_dst(conn), addr, sizeof(addr));

	if (err) {
		LOG_ERR("Security failed: %s level %u err %d", addr, level, err);
		bt_conn_disconnect(conn, BT_HCI_ERR_AUTH_FAIL);
		return;
	}

	LOG_INF("Security changed: %s level %u", addr, level);

	/* Security established, now discover HOGP service */
	hogp_client_discover(conn);
}

static void le_param_updated(struct bt_conn *conn, uint16_t interval,
			     uint16_t latency, uint16_t timeout)
{
	LOG_INF("Connection params updated: interval %u (%.2f ms), "
		"latency %u, timeout %u",
		interval, interval * 1.25, latency, timeout);
}

BT_CONN_CB_DEFINE(conn_callbacks) = {
	.connected = connected,
	.disconnected = disconnected,
	.security_changed = security_changed,
	.le_param_updated = le_param_updated,
};

static void add_bonded_addr_filter(const struct bt_bond_info *info, void *user_data)
{
	int err;

	err = bt_scan_filter_add(BT_SCAN_FILTER_TYPE_ADDR, &info->addr);
	if (err) {
		LOG_ERR("Failed to add bonded address filter: %d", err);
	} else {
		char addr[BT_ADDR_LE_STR_LEN];
		bt_addr_le_to_str(&info->addr, addr, sizeof(addr));
		LOG_INF("Added bonded address filter: %s", addr);
	}
}

int ble_central_add_bonded_filter(const bt_addr_le_t *addr)
{
	int err;

	err = bt_scan_filter_add(BT_SCAN_FILTER_TYPE_ADDR, addr);
	if (err) {
		LOG_ERR("Failed to add bonded address filter: %d", err);
		return err;
	}

	char addr_str[BT_ADDR_LE_STR_LEN];
	bt_addr_le_to_str(addr, addr_str, sizeof(addr_str));
	LOG_INF("Added bonded address filter: %s", addr_str);
	return 0;
}

int ble_central_init(void)
{
	int err;

	/* Initialize Bluetooth */
	err = bt_enable(NULL);
	if (err) {
		LOG_ERR("Bluetooth init failed: %d", err);
		return err;
	}

	LOG_INF("Bluetooth initialized");

	/* Register debug callback to see ALL devices */
	bt_le_scan_cb_register(&scan_debug_cb);
	printk("[DEBUG] Debug scan callback registered - will show ALL BLE devices\n");

	/* Load stored bonds */
	settings_load();

	/* Initialize pairing callbacks */
	pairing_init();

	/* Initialize scan module */
	struct bt_scan_init_param scan_init = {
		.connect_if_match = 1,
		.scan_param = NULL, /* Use default params */
		.conn_param = &conn_param,
	};

	bt_scan_init(&scan_init);
	bt_scan_cb_register(&scan_cb);

	/* Add filter for HID Service UUID */
	err = bt_scan_filter_add(BT_SCAN_FILTER_TYPE_UUID, &hid_uuid);
	if (err) {
		LOG_ERR("Failed to add UUID filter: %d", err);
		return err;
	}

	/* Load existing bonds as address filters for fast reconnection */
	bt_foreach_bond(BT_ID_DEFAULT, add_bonded_addr_filter, NULL);

	/* Enable filters - use OR mode (not match_all) so we match
	 * EITHER the UUID OR the Address of a bonded device.
	 */
	err = bt_scan_filter_enable(BT_SCAN_UUID_FILTER | BT_SCAN_ADDR_FILTER, false);
	if (err) {
		LOG_ERR("Failed to enable filters: %d", err);
		return err;
	}

	LOG_INF("BLE Central initialized");
	return 0;
}

int ble_central_start_scan(void)
{
	int err;

	if (scanning) {
		return 0;
	}

	if (current_conn) {
		LOG_INF("Already connected, not scanning");
		return 0;
	}

	err = bt_scan_start(BT_SCAN_TYPE_SCAN_ACTIVE);
	if (err) {
		LOG_ERR("Scanning failed to start: %d", err);
		return err;
	}

	scanning = true;
	LOG_INF("Scanning for HID devices...");
	return 0;
}

void ble_central_stop_scan(void)
{
	if (!scanning) {
		return;
	}

	bt_scan_stop();
	scanning = false;
	LOG_INF("Scanning stopped");
}

struct bt_conn *ble_central_get_conn(void)
{
	return current_conn;
}

bool ble_central_is_connected(void)
{
	return current_conn != NULL;
}

int ble_central_disconnect(void)
{
	if (!current_conn) {
		return -ENOTCONN;
	}

	return bt_conn_disconnect(current_conn, BT_HCI_ERR_REMOTE_USER_TERM_CONN);
}
```

## src/ble_central.h
```c
/* SPDX-License-Identifier: Apache-2.0 */

#ifndef BLE_CENTRAL_H_
#define BLE_CENTRAL_H_

#include <zephyr/bluetooth/bluetooth.h>
#include <zephyr/bluetooth/conn.h>

/**
 * Initialize BLE central mode and start scanning for HID devices
 * @return 0 on success, negative error code on failure
 */
int ble_central_init(void);

/**
 * Start scanning for BLE HID devices
 * @return 0 on success, negative error code on failure
 */
int ble_central_start_scan(void);

/**
 * Stop scanning
 */
void ble_central_stop_scan(void);

/**
 * Register a bonded device for reconnection scanning
 * @param addr Pointer to device address
 * @return 0 on success, negative error code on failure
 */
int ble_central_add_bonded_filter(const bt_addr_le_t *addr);

/**
 * Get the current BLE connection
 * @return Pointer to connection object, or NULL if not connected
 */
struct bt_conn *ble_central_get_conn(void);

/**
 * Check if connected to a HID device
 * @return true if connected, false otherwise
 */
bool ble_central_is_connected(void);

/**
 * Disconnect from current device
 * @return 0 on success, negative error code on failure
 */
int ble_central_disconnect(void);

#endif /* BLE_CENTRAL_H_ */
```

## src/hid_bridge.c
```c
/* SPDX-License-Identifier: Apache-2.0 */

#include <zephyr/kernel.h>
#include <zephyr/drivers/gpio.h>
#include <zephyr/logging/log.h>

#include "hid_bridge.h"
#include "usb_hid.h"
#include "hogp_client.h"

LOG_MODULE_REGISTER(hid_bridge, LOG_LEVEL_INF);

/* NKRO report parameters (ZMK default NKRO: 15 bytes) */
#define NKRO_REPORT_LEN		15
#define NKRO_BITMAP_OFFSET	2 /* modifier(1) + reserved(1) */
#define NKRO_BITMAP_LEN		13 /* 13 bytes = 104 key bits */
#define BOOT_REPORT_LEN		8
#define BOOT_MAX_KEYS		6

/**
 * Convert a ZMK NKRO report (15 bytes) to boot keyboard format (8 bytes).
 */
static void nkro_to_boot(const uint8_t *nkro, uint8_t *boot)
{
	memset(boot, 0, BOOT_REPORT_LEN);

	/* Modifier byte is identical in both formats */
	boot[0] = nkro[0];
	/* boot[1] = 0 (reserved) */

	uint8_t key_idx = 0;

	for (int byte = 0; byte < NKRO_BITMAP_LEN && key_idx < BOOT_MAX_KEYS; byte++) {
		uint8_t bits = nkro[NKRO_BITMAP_OFFSET + byte];
		if (!bits) {
			continue;
		}
		for (int bit = 0; bit < 8 && key_idx < BOOT_MAX_KEYS; bit++) {
			if (bits & (1 << bit)) {
				uint8_t keycode = (byte * 8) + bit;
				/* Keycodes 0-3 are reserved/error in HID spec */
				if (keycode >= 4) {
					boot[2 + key_idx] = keycode;
					key_idx++;
				}
			}
		}
	}
}

/* LED for status indication - use built-in LED on XIAO */
static const struct gpio_dt_spec led = GPIO_DT_SPEC_GET_OR(DT_ALIAS(led0), gpios, {0});

/* Statistics */
static uint32_t reports_received;
static uint32_t reports_forwarded;
static uint32_t reports_dropped;

/* Last report for deduplication (optional) */
static uint8_t last_report[8];

/* Work queue for LED blink on activity */
static struct k_work_delayable led_off_work;

static void led_off_handler(struct k_work *work)
{
	if (led.port) {
		gpio_pin_set_dt(&led, 0);
	}
}

static void led_blink(void)
{
	if (led.port) {
		gpio_pin_set_dt(&led, 1);
		k_work_reschedule(&led_off_work, K_MSEC(10));
	}
}

int hid_bridge_init(void)
{
	int err;

	/* Initialize LED */
	if (led.port && device_is_ready(led.port)) {
		err = gpio_pin_configure_dt(&led, GPIO_OUTPUT_INACTIVE);
		if (err) {
			LOG_WRN("Failed to configure LED: %d", err);
		} else {
			LOG_INF("Status LED configured");
		}
	}

	k_work_init_delayable(&led_off_work, led_off_handler);

	/* Initialize HOGP client with our report callback */
	err = hogp_client_init(hid_bridge_handle_report);
	if (err) {
		LOG_ERR("Failed to init HOGP client: %d", err);
		return err;
	}

	LOG_INF("HID bridge initialized");
	return 0;
}

void hid_bridge_handle_report(const uint8_t *report, uint8_t len)
{
	int err;
	uint8_t usb_report[BOOT_REPORT_LEN] = {0};

	reports_received++;

	if (len == NKRO_REPORT_LEN) {
		/* ZMK NKRO report - convert bitmap to 6KRO boot format */
		nkro_to_boot(report, usb_report);
	} else if (len == BOOT_REPORT_LEN) {
		/* Standard boot report - use as-is */
		memcpy(usb_report, report, BOOT_REPORT_LEN);
	} else {
		LOG_WRN("Unexpected report length: %u", len);
		/* Best effort: copy what fits */
		memcpy(usb_report, report, len < BOOT_REPORT_LEN ? len : BOOT_REPORT_LEN);
	}

	/* Log the report for debugging */
	LOG_DBG("BLE report: %02x %02x %02x %02x %02x %02x %02x %02x",
		report[0], len > 1 ? report[1] : 0,
		len > 2 ? report[2] : 0, len > 3 ? report[3] : 0,
		len > 4 ? report[4] : 0, len > 5 ? report[5] : 0,
		len > 6 ? report[6] : 0, len > 7 ? report[7] : 0);

	/* Check if USB is ready */
	if (!app_usb_hid_ready()) {
		reports_dropped++;
		if (reports_dropped % 100 == 1) {
			LOG_WRN("USB not ready, reports dropped: %u", reports_dropped);
		}
		return;
	}

	err = app_usb_hid_send_report(usb_report);
	if (err) {
		reports_dropped++;
		LOG_DBG("Failed to send USB report: %d", err);
		return;
	}

	reports_forwarded++;

	/* Blink LED on activity */
	led_blink();

	/* Store for potential deduplication */
	memcpy(last_report, usb_report, 8);

	/* Periodic stats logging */
	if (reports_forwarded % 1000 == 0) {
		LOG_INF("Stats: received=%u, forwarded=%u, dropped=%u",
			reports_received, reports_forwarded, reports_dropped);
	}
}

void hid_bridge_on_disconnect(void)
{
	LOG_INF("BLE disconnected, releasing all keys");

	/* Release all keys to prevent stuck keys */
	app_usb_hid_release_all();

	/* Clear last report */
	memset(last_report, 0, sizeof(last_report));
}
```

## src/hid_bridge.h
```c
/* SPDX-License-Identifier: Apache-2.0 */

#ifndef HID_BRIDGE_H_
#define HID_BRIDGE_H_

#include <stdint.h>

/**
 * Initialize the HID bridge
 * Sets up the connection between BLE HOGP reports and USB HID output
 * @return 0 on success, negative error code on failure
 */
int hid_bridge_init(void);

/**
 * Handle incoming BLE HID report and forward to USB
 * Called from HOGP client when a report is received
 * @param report Pointer to report data (8 bytes for boot keyboard)
 * @param len Length of report data
 */
void hid_bridge_handle_report(const uint8_t *report, uint8_t len);

/**
 * Handle BLE disconnection
 * Releases all keys on USB to prevent stuck keys
 */
void hid_bridge_on_disconnect(void);

#endif /* HID_BRIDGE_H_ */
```

## src/hogp_client.c
```c
/* SPDX-License-Identifier: Apache-2.0 */

#include <zephyr/kernel.h>
#include <zephyr/bluetooth/bluetooth.h>
#include <zephyr/bluetooth/conn.h>
#include <zephyr/bluetooth/gatt.h>
#include <bluetooth/gatt_dm.h>
#include <bluetooth/services/hogp.h>
#include <bluetooth/services/hids.h>
#include <zephyr/logging/log.h>

#include "hogp_client.h"

LOG_MODULE_REGISTER(hogp_client, LOG_LEVEL_INF);

static struct bt_hogp hogp;
static hogp_report_cb_t report_callback;
static bool hogp_ready;
static uint8_t subscribed_reports;

/* Input report notification handler */
static uint8_t hogp_report_notify(struct bt_hogp *hogp_ctx,
				  struct bt_hogp_rep_info *rep,
				  uint8_t err,
				  const uint8_t *data)
{
	if (err) {
		LOG_ERR("Report notification error: %u", err);
		return BT_GATT_ITER_STOP;
	}

	if (!data) {
		LOG_DBG("Report unsubscribed (id=%u)", bt_hogp_rep_id(rep));
		return BT_GATT_ITER_STOP;
	}

	uint8_t id = bt_hogp_rep_id(rep);
	size_t len = bt_hogp_rep_size(rep);

	LOG_DBG("Report received: id=%u, len=%zu", id, len);

	/* Forward to registered callback */
	if (report_callback) {
		report_callback(data, len);
	}

	return BT_GATT_ITER_CONTINUE;
}

/* HOGP ready callback */
static void hogp_ready_cb(struct bt_hogp *hogp_ctx)
{
	int err;
	struct bt_hogp_rep_info *rep = NULL;
	size_t rep_count;

	LOG_INF("HOGP service ready");

	rep_count = bt_hogp_rep_count(hogp_ctx);
	LOG_INF("Found %zu HID reports", rep_count);

	subscribed_reports = 0;

	/* Iterate through all reports and subscribe to input reports */
	while ((rep = bt_hogp_rep_next(hogp_ctx, rep)) != NULL) {
		uint8_t rep_id = bt_hogp_rep_id(rep);
		enum bt_hids_report_type rep_type = bt_hogp_rep_type(rep);

		LOG_INF("Report: id=%u, type=%u", rep_id, rep_type);

		/* Subscribe to input reports only */
		if (rep_type == BT_HIDS_REPORT_TYPE_INPUT) {
			err = bt_hogp_rep_subscribe(hogp_ctx, rep, hogp_report_notify);
			if (err) {
				LOG_ERR("Failed to subscribe to report %u: %d", rep_id, err);
			} else {
				LOG_INF("Subscribed to input report %u", rep_id);
				subscribed_reports++;
			}
		}
	}

	if (subscribed_reports > 0) {
		LOG_INF("Subscribed to %u input reports", subscribed_reports);
		hogp_ready = true;
	} else {
		LOG_ERR("No input reports found to subscribe");
	}
}

/* HOGP protocol mode change callback */
static void hogp_pm_update_cb(struct bt_hogp *hogp_ctx)
{
	uint8_t pm = bt_hogp_pm_get(hogp_ctx);
	LOG_INF("Protocol mode: %s", pm == BT_HIDS_PM_BOOT ? "Boot" : "Report");
}

static struct bt_hogp_init_params hogp_init_params = {
	.ready_cb = hogp_ready_cb,
	.pm_update_cb = hogp_pm_update_cb,
};

/* GATT Discovery completed callback */
static void discovery_completed(struct bt_gatt_dm *dm, void *ctx)
{
	int err;

	ARG_UNUSED(ctx);
	LOG_INF("GATT discovery completed");

	bt_gatt_dm_data_print(dm);

	/* Initialize HOGP with discovered services */
	err = bt_hogp_handles_assign(dm, &hogp);
	if (err) {
		LOG_ERR("Failed to assign HOGP handles: %d", err);
		goto release;
	}

	/* Use Report Protocol mode (default) - no need to switch to boot mode.
	 * Modern keyboards like ZMK only support Report Protocol which provides
	 * more features (consumer keys, etc.).
	 */

release:
	err = bt_gatt_dm_data_release(dm);
	if (err) {
		LOG_ERR("Failed to release discovery data: %d", err);
	}
}

/* GATT Discovery service not found callback */
static void discovery_service_not_found(struct bt_conn *conn, void *ctx)
{
	LOG_ERR("HID service not found");
}

/* GATT Discovery error callback */
static void discovery_error_found(struct bt_conn *conn, int err, void *ctx)
{
	LOG_ERR("GATT discovery error: %d", err);
}

static struct bt_gatt_dm_cb discovery_cb = {
	.completed = discovery_completed,
	.service_not_found = discovery_service_not_found,
	.error_found = discovery_error_found,
};

int hogp_client_init(hogp_report_cb_t cb)
{
	report_callback = cb;
	hogp_ready = false;

	bt_hogp_init(&hogp, &hogp_init_params);

	LOG_INF("HOGP client initialized");
	return 0;
}

int hogp_client_discover(struct bt_conn *conn)
{
	int err;

	LOG_INF("Starting HOGP discovery...");
	hogp_ready = false;

	err = bt_gatt_dm_start(conn, BT_UUID_HIDS, &discovery_cb, NULL);
	if (err) {
		LOG_ERR("Failed to start GATT discovery: %d", err);
		return err;
	}

	return 0;
}

bool hogp_client_ready(void)
{
	return hogp_ready;
}
```

## src/hogp_client.h
```c
/* SPDX-License-Identifier: Apache-2.0 */

#ifndef HOGP_CLIENT_H_
#define HOGP_CLIENT_H_

#include <zephyr/bluetooth/conn.h>

/**
 * Callback type for receiving HID input reports
 * @param report Pointer to report data
 * @param len Length of report data
 */
typedef void (*hogp_report_cb_t)(const uint8_t *report, uint8_t len);

/**
 * Initialize HOGP client
 * @param cb Callback for received HID reports
 * @return 0 on success, negative error code on failure
 */
int hogp_client_init(hogp_report_cb_t cb);

/**
 * Start HOGP service discovery on a connection
 * @param conn BLE connection
 * @return 0 on success, negative error code on failure
 */
int hogp_client_discover(struct bt_conn *conn);

/**
 * Check if HOGP discovery is complete and subscribed to reports
 * @return true if ready, false otherwise
 */
bool hogp_client_ready(void);

#endif /* HOGP_CLIENT_H_ */
```

## src/pairing.c
```c
/* SPDX-License-Identifier: Apache-2.0 */

#include <zephyr/kernel.h>
#include <zephyr/bluetooth/bluetooth.h>
#include <zephyr/bluetooth/conn.h>
#include <zephyr/settings/settings.h>
#include <zephyr/logging/log.h>

#include "pairing.h"
#include "ble_central.h"

LOG_MODULE_REGISTER(pairing, LOG_LEVEL_INF);

/*
 * Passkey display callback
 * Called when the Corne keyboard requests pairing
 * The passkey is displayed on USB serial console
 * User must enter this passkey on the Corne keyboard
 */
static void auth_passkey_display(struct bt_conn *conn, unsigned int passkey)
{
	char addr[BT_ADDR_LE_STR_LEN];

	bt_addr_le_to_str(bt_conn_get_dst(conn), addr, sizeof(addr));

	LOG_INF("========================================");
	LOG_INF("PAIRING REQUEST from %s", addr);
	LOG_INF("Enter this passkey on your keyboard:");
	LOG_INF("");
	LOG_INF("        %06u", passkey);
	LOG_INF("");
	LOG_INF("========================================");

	/* Also print to console directly for visibility */
	printk("\n");
	printk("========================================\n");
	printk("PAIRING REQUEST from %s\n", addr);
	printk("Enter this passkey on your keyboard:\n");
	printk("\n");
	printk("        %06u\n", passkey);
	printk("\n");
	printk("========================================\n");
	printk("\n");
}

/*
 * Passkey entry request callback
 * This is called if WE need to enter a passkey
 * For this use case, we display passkey, not enter it
 */
static void auth_passkey_entry(struct bt_conn *conn)
{
	char addr[BT_ADDR_LE_STR_LEN];

	bt_addr_le_to_str(bt_conn_get_dst(conn), addr, sizeof(addr));
	LOG_WRN("Passkey entry requested by %s - not supported", addr);

	/* Cancel authentication - we can only display passkeys */
	bt_conn_auth_cancel(conn);
}

/*
 * Pairing confirmation callback
 * Called for Just Works pairing or numeric comparison
 */
static void auth_passkey_confirm(struct bt_conn *conn, unsigned int passkey)
{
	char addr[BT_ADDR_LE_STR_LEN];

	bt_addr_le_to_str(bt_conn_get_dst(conn), addr, sizeof(addr));
	LOG_INF("Passkey confirm for %s: %06u", addr, passkey);

	/* Auto-confirm for numeric comparison */
	bt_conn_auth_passkey_confirm(conn);
}

/*
 * Pairing cancelled callback
 */
static void auth_cancel(struct bt_conn *conn)
{
	char addr[BT_ADDR_LE_STR_LEN];

	bt_addr_le_to_str(bt_conn_get_dst(conn), addr, sizeof(addr));
	LOG_WRN("Pairing cancelled: %s", addr);
}

/*
 * Pairing completed callback
 */
static void pairing_complete(struct bt_conn *conn, bool bonded)
{
	char addr[BT_ADDR_LE_STR_LEN];

	bt_addr_le_to_str(bt_conn_get_dst(conn), addr, sizeof(addr));

	if (bonded) {
		LOG_INF("========================================");
		LOG_INF("PAIRING SUCCESSFUL with %s", addr);
		LOG_INF("Bond stored - will auto-reconnect");
		LOG_INF("========================================");

		printk("\n");
		printk("========================================\n");
		printk("PAIRING SUCCESSFUL with %s\n", addr);
		printk("Bond stored - will auto-reconnect\n");
		printk("========================================\n");
		printk("\n");

		/* Register this device for fast reconnection scan filtering */
		ble_central_add_bonded_filter(bt_conn_get_dst(conn));
	} else {
		LOG_INF("Pairing complete (not bonded): %s", addr);
	}
}

/*
 * Pairing failed callback
 */
static void pairing_failed(struct bt_conn *conn, enum bt_security_err reason)
{
	char addr[BT_ADDR_LE_STR_LEN];

	bt_addr_le_to_str(bt_conn_get_dst(conn), addr, sizeof(addr));
	LOG_ERR("Pairing failed: %s, reason %d", addr, reason);

	printk("\n");
	printk("PAIRING FAILED with %s (reason %d)\n", addr, reason);
	printk("Please try again.\n");
	printk("\n");
}

/* Authentication callbacks */
static struct bt_conn_auth_cb auth_cb = {
	.passkey_display = auth_passkey_display,
	.passkey_entry = auth_passkey_entry,
	.passkey_confirm = auth_passkey_confirm,
	.cancel = auth_cancel,
};

/* Pairing info callbacks */
static struct bt_conn_auth_info_cb auth_info_cb = {
	.pairing_complete = pairing_complete,
	.pairing_failed = pairing_failed,
};

void pairing_init(void)
{
	int err;

	err = bt_conn_auth_cb_register(&auth_cb);
	if (err) {
		LOG_ERR("Failed to register auth callbacks: %d", err);
	}

	err = bt_conn_auth_info_cb_register(&auth_info_cb);
	if (err) {
		LOG_ERR("Failed to register auth info callbacks: %d", err);
	}

	LOG_INF("Pairing callbacks registered");
	LOG_INF("Passkeys will be displayed on USB serial console");
}

/* Helper to iterate and unpair all bonds */
static void unpair_cb(const struct bt_bond_info *info, void *user_data)
{
	int err;
	char addr[BT_ADDR_LE_STR_LEN];

	bt_addr_le_to_str(&info->addr, addr, sizeof(addr));

	err = bt_unpair(BT_ID_DEFAULT, &info->addr);
	if (err) {
		LOG_ERR("Failed to unpair %s: %d", addr, err);
	} else {
		LOG_INF("Unpaired: %s", addr);
	}
}

int pairing_clear_bonds(void)
{
	LOG_INF("Clearing all bonds...");
	bt_foreach_bond(BT_ID_DEFAULT, unpair_cb, NULL);
	LOG_INF("All bonds cleared");
	return 0;
}
```

## src/pairing.h
```c
/* SPDX-License-Identifier: Apache-2.0 */

#ifndef PAIRING_H_
#define PAIRING_H_

/**
 * Initialize pairing callbacks for passkey display
 * This sets up Bluetooth authentication callbacks for
 * displaying pairing passkeys over USB serial console
 */
void pairing_init(void);

/**
 * Clear all stored bonds
 * @return 0 on success, negative error code on failure
 */
int pairing_clear_bonds(void);

#endif /* PAIRING_H_ */
```

## src/usb_hid.c
```c
/* SPDX-License-Identifier: Apache-2.0 */

#include <zephyr/kernel.h>
#include <zephyr/device.h>
#include <zephyr/usb/usb_device.h>
#include <zephyr/usb/class/usb_hid.h>
#include <zephyr/logging/log.h>

#include "usb_hid.h"

LOG_MODULE_REGISTER(app_usb_hid, LOG_LEVEL_INF);

/* Boot keyboard HID report descriptor */
static const uint8_t hid_report_desc[] = {
	/* Usage Page (Generic Desktop) */
	0x05, 0x01,
	/* Usage (Keyboard) */
	0x09, 0x06,
	/* Collection (Application) */
	0xA1, 0x01,

	/* Modifier keys (8 bits) */
	/* Usage Page (Key Codes) */
	0x05, 0x07,
	/* Usage Minimum (Left Control) */
	0x19, 0xE0,
	/* Usage Maximum (Right GUI) */
	0x29, 0xE7,
	/* Logical Minimum (0) */
	0x15, 0x00,
	/* Logical Maximum (1) */
	0x25, 0x01,
	/* Report Size (1) */
	0x75, 0x01,
	/* Report Count (8) */
	0x95, 0x08,
	/* Input (Data, Variable, Absolute) */
	0x81, 0x02,

	/* Reserved byte */
	/* Report Count (1) */
	0x95, 0x01,
	/* Report Size (8) */
	0x75, 0x08,
	/* Input (Constant) */
	0x81, 0x01,

	/* LED output report (for Caps/Num/Scroll Lock LEDs) */
	/* Usage Page (LEDs) */
	0x05, 0x08,
	/* Usage Minimum (Num Lock) */
	0x19, 0x01,
	/* Usage Maximum (Scroll Lock) */
	0x29, 0x03,
	/* Report Count (3) */
	0x95, 0x03,
	/* Report Size (1) */
	0x75, 0x01,
	/* Output (Data, Variable, Absolute) */
	0x91, 0x02,
	/* Report Count (1) */
	0x95, 0x01,
	/* Report Size (5) */
	0x75, 0x05,
	/* Output (Constant) */
	0x91, 0x01,

	/* Key array (6 keys) */
	/* Usage Page (Key Codes) */
	0x05, 0x07,
	/* Usage Minimum (0) */
	0x19, 0x00,
	/* Usage Maximum (101) */
	0x29, 0x65,
	/* Logical Minimum (0) */
	0x15, 0x00,
	/* Logical Maximum (101) */
	0x25, 0x65,
	/* Report Count (6) */
	0x95, 0x06,
	/* Report Size (8) */
	0x75, 0x08,
	/* Input (Data, Array) */
	0x81, 0x00,

	/* End Collection */
	0xC0
};

static const struct device *hid_dev;
static bool usb_configured;
static bool hid_ready;
static K_SEM_DEFINE(hid_sem, 1, 1);

static void int_in_ready_cb(const struct device *dev)
{
	ARG_UNUSED(dev);
	k_sem_give(&hid_sem);
}

static void status_cb(enum usb_dc_status_code status, const uint8_t *param)
{
	ARG_UNUSED(param);

	switch (status) {
	case USB_DC_CONFIGURED:
		LOG_INF("USB configured");
		usb_configured = true;
		/* Signal HID endpoint ready */
		if (hid_dev) {
			int_in_ready_cb(hid_dev);
		}
		break;
	case USB_DC_DISCONNECTED:
		LOG_INF("USB disconnected");
		usb_configured = false;
		break;
	case USB_DC_SUSPEND:
		LOG_DBG("USB suspended");
		break;
	case USB_DC_RESUME:
		LOG_DBG("USB resumed");
		break;
	default:
		break;
	}
}

static const struct hid_ops hid_ops = {
	.int_in_ready = int_in_ready_cb,
};

int app_usb_hid_init(void)
{
	int ret;

	LOG_INF("Looking for HID device...");

	hid_dev = device_get_binding("HID_0");
	if (hid_dev == NULL) {
		LOG_ERR("Cannot get HID device binding - HID_0 not found");
		LOG_ERR("USB HID will not be available");
		return -ENODEV;
	}

	LOG_INF("Found HID device: %s", hid_dev->name);

	usb_hid_register_device(hid_dev, hid_report_desc,
				sizeof(hid_report_desc), &hid_ops);

	if (usb_hid_set_proto_code(hid_dev, HID_BOOT_IFACE_CODE_KEYBOARD)) {
		LOG_WRN("Failed to set Protocol Code");
	}

	ret = usb_hid_init(hid_dev);
	if (ret != 0) {
		LOG_ERR("Failed to init HID device: %d", ret);
		return ret;
	}

	/* Try to enable USB - ignore error if already enabled (by CDC ACM console) */
	ret = usb_enable(status_cb);
	if (ret != 0 && ret != -EALREADY) {
		LOG_ERR("Failed to enable USB: %d", ret);
		return ret;
	}

	if (ret == -EALREADY) {
		LOG_INF("USB already enabled (by console)");
		/* Check if already configured */
		usb_configured = true;
	}

	hid_ready = true;
	LOG_INF("USB HID keyboard initialized");
	return 0;
}

int app_usb_hid_send_report(const uint8_t *report)
{
	int ret;

	if (!hid_ready || !hid_dev) {
		return -ENODEV;
	}

	if (!usb_configured) {
		return -ENOTCONN;
	}

	/* Wait for previous report to complete */
	ret = k_sem_take(&hid_sem, K_MSEC(100));
	if (ret != 0) {
		LOG_WRN("HID report timeout");
		return ret;
	}

	ret = hid_int_ep_write(hid_dev, report, APP_USB_HID_REPORT_SIZE, NULL);
	if (ret != 0) {
		LOG_ERR("Failed to send HID report: %d", ret);
		k_sem_give(&hid_sem);
		return ret;
	}

	return 0;
}

int app_usb_hid_release_all(void)
{
	static const uint8_t empty_report[APP_USB_HID_REPORT_SIZE] = {0};

	LOG_DBG("Releasing all keys");
	return app_usb_hid_send_report(empty_report);
}

bool app_usb_hid_ready(void)
{
	return hid_ready && usb_configured;
}
```

## src/usb_hid.h
```c
/* SPDX-License-Identifier: Apache-2.0 */

#ifndef APP_USB_HID_H_
#define APP_USB_HID_H_

#include <stdint.h>
#include <stdbool.h>

/* Boot keyboard report: 8 bytes
 * Byte 0: Modifier keys (Ctrl, Shift, Alt, GUI)
 * Byte 1: Reserved
 * Bytes 2-7: Key codes (up to 6 simultaneous keys)
 */
#define APP_USB_HID_REPORT_SIZE 8

/**
 * Initialize USB HID keyboard device
 * @return 0 on success, negative error code on failure
 */
int app_usb_hid_init(void);

/**
 * Send a keyboard report over USB
 * @param report Pointer to 8-byte boot keyboard report
 * @return 0 on success, negative error code on failure
 */
int app_usb_hid_send_report(const uint8_t *report);

/**
 * Release all keys (send empty report)
 * Used when BLE disconnects to prevent stuck keys
 * @return 0 on success, negative error code on failure
 */
int app_usb_hid_release_all(void);

/**
 * Check if USB HID is ready to send reports
 * @return true if ready, false otherwise
 */
bool app_usb_hid_ready(void);

#endif /* APP_USB_HID_H_ */
```
